## CMakeLists.txt
```
cmake_minimum_required(VERSION 3.20.0)
find_package(Zephyr REQUIRED HINTS $ENV{ZEPHYR_BASE})
project(protopilot)

target_sources(app PRIVATE
	src/main.c
	src/typer.c
	src/keymap_de.c
)

if(CONFIG_BOARD_NRF52840_MDK_USB_DONGLE)
	target_sources(app PRIVATE src/regout.c)
endif()
```

## prj.conf
```kconfig
# --- Allgemein ---
CONFIG_GPIO=y
CONFIG_RING_BUFFER=y
CONFIG_MAIN_STACK_SIZE=2048
CONFIG_SYSTEM_WORKQUEUE_STACK_SIZE=2048

# Keine serielle Konsole
CONFIG_SERIAL=n
CONFIG_CONSOLE=n
CONFIG_UART_CONSOLE=n
CONFIG_LOG=n

# --- USB-Tastatur ---
CONFIG_USB_DEVICE_STACK=y
CONFIG_USB_DEVICE_HID=y
CONFIG_USB_DEVICE_INITIALIZE_AT_BOOT=n
CONFIG_USB_DEVICE_MANUFACTURER="ProtoPilot"
CONFIG_USB_DEVICE_PRODUCT="ProtoPilot Keyboard"
CONFIG_USB_DEVICE_PID=0x0D0C
CONFIG_USB_HID_BOOT_PROTOCOL=y
CONFIG_USB_HID_POLL_INTERVAL_MS=1
CONFIG_USB_DEVICE_REMOTE_WAKEUP=n

# --- Bluetooth ---
CONFIG_BT=y
CONFIG_BT_PERIPHERAL=y
CONFIG_BT_DEVICE_NAME="ProtoPilot"
CONFIG_BT_MAX_CONN=1
CONFIG_BT_SMP=y
CONFIG_BT_SMP_APP_PAIRING_ACCEPT=y
CONFIG_BT_MAX_PAIRED=4
CONFIG_BT_KEYS_OVERWRITE_OLDEST=y
CONFIG_BT_PRIVACY=n

# Kopplungen dauerhaft speichern
CONFIG_BT_SETTINGS=y
CONFIG_SETTINGS=y
CONFIG_FLASH=y
CONFIG_FLASH_MAP=y
CONFIG_NVS=y
```

## boards/nrf52840_mdk_usb_dongle_nrf52840.conf
```kconfig
# Makerdiary nRF52840 MDK USB Dongle: sicher unabhaengig von der Bestueckung.
# Interner RC-Oszillator statt 32-kHz-Quarz und Spannungsregler im LDO-Modus
# (DCDC braucht eine Spule auf der Platine). Am USB-Anschluss spielt der etwas
# hoehere Stromverbrauch keine Rolle.
CONFIG_CLOCK_CONTROL_NRF_K32SRC_RC=y
CONFIG_BOARD_ENABLE_DCDC=n
```

## boards/nrf52840dongle_nrf52840.conf
```kconfig
# Keine serielle USB-Konsole: der Dongle soll sich nur als Tastatur melden
CONFIG_BOARD_SERIAL_BACKEND_CDC_ACM=n
```

## boards/nrf52840_mdk_usb_dongle_nrf52840.overlay
```dts
/*
 * Makerdiary nRF52840 MDK USB Dongle: RGB-LED.
 * Die einzige Taste ist der Reset-Pin; Druecken startet den Dongle neu
 * und oeffnet damit das Kopplungsfenster.
 */
/ {
	aliases {
		ds-red = &led0_red;
		ds-green = &led0_green;
		ds-blue = &led0_blue;
	};
};
```

## boards/nrf52840dongle_nrf52840.overlay
```dts
/* Nordic nRF52840 Dongle (PCA10059): RGB-LED und Taste SW1 */
/ {
	aliases {
		ds-red = &led1_red;
		ds-green = &led1_green;
		ds-blue = &led1_blue;
		ds-button = &button0;
	};
};
```

## src/main.c
```c
/*
 * ProtoPilot: Bluetooth-zu-USB-Tastatur fuer nRF52840-Dongles
 * (Nordic PCA10059, Makerdiary nRF52840 MDK USB Dongle).
 *
 * Das Smartphone verbindet sich per Bluetooth LE und schickt Text,
 * der Dongle tippt ihn als USB-Tastatur am Zielgeraet ein.
 *
 * Kopplung: nach dem Einstecken (bzw. Neustart) 60 s moeglich, LED blinkt blau.
 * Nordic-Dongle zusaetzlich mit Taste SW1:
 *             kurz druecken   -> Kopplungsmodus fuer 60 s
 *             5 s halten      -> alle Kopplungen loeschen (LED leuchtet rot)
 */
#include "typer.h"

#include <zephyr/bluetooth/bluetooth.h>
#include <zephyr/bluetooth/conn.h>
#include <zephyr/bluetooth/gatt.h>
#include <zephyr/bluetooth/uuid.h>
#include <zephyr/drivers/gpio.h>
#include <zephyr/kernel.h>
#include <zephyr/settings/settings.h>
#include <zephyr/sys/byteorder.h>

#define FW_VERSION 4

#define PAIRING_WINDOW_MS   (60 * 1000)
#define ERASE_HOLD_MS       5000
#define STATUS_INTERVAL_MS  150

/* Befehle auf der Befehls-Charakteristik (erstes Byte) */
#define CMD_DATA      0x01 /* Datenstrom, siehe typer.h */
#define CMD_CANCEL    0x02 /* Tippen abbrechen */
#define CMD_DELAY     0x03 /* Tippverzoegerung in ms setzen */
#define CMD_UNPAIR    0x04 /* alle Kopplungen loeschen */

/* ATT-Anwendungsfehler: Warteschlange voll, spaeter erneut senden */
#define ERR_QUEUE_FULL 0x80

#define STATUS_USB_READY  BIT(0)
#define STATUS_CAPS_LOCK  BIT(1)
#define STATUS_TYPING     BIT(2)
#define STATUS_PAIRING    BIT(3)

#define BT_UUID_DS_SVC_VAL    BT_UUID_128_ENCODE(0x6e7a0001, 0x4b3c, 0x4f8e, 0x9a1d, 0x5c2b7d0a4e01)
#define BT_UUID_DS_CMD_VAL    BT_UUID_128_ENCODE(0x6e7a0002, 0x4b3c, 0x4f8e, 0x9a1d, 0x5c2b7d0a4e01)
#define BT_UUID_DS_STATUS_VAL BT_UUID_128_ENCODE(0x6e7a0003, 0x4b3c, 0x4f8e, 0x9a1d, 0x5c2b7d0a4e01)

static const struct bt_uuid_128 ds_svc_uuid = BT_UUID_INIT_128(BT_UUID_DS_SVC_VAL);
static const struct bt_uuid_128 ds_cmd_uuid = BT_UUID_INIT_128(BT_UUID_DS_CMD_VAL);
static const struct bt_uuid_128 ds_status_uuid = BT_UUID_INIT_128(BT_UUID_DS_STATUS_VAL);

#define HAS_BUTTON DT_NODE_EXISTS(DT_ALIAS(ds_button))

#if HAS_BUTTON
static const struct gpio_dt_spec btn = GPIO_DT_SPEC_GET(DT_ALIAS(ds_button), gpios);
#endif
static const struct gpio_dt_spec led_red = GPIO_DT_SPEC_GET(DT_ALIAS(ds_red), gpios);
static const struct gpio_dt_spec led_green = GPIO_DT_SPEC_GET(DT_ALIAS(ds_green), gpios);
static const struct gpio_dt_spec led_blue = GPIO_DT_SPEC_GET(DT_ALIAS(ds_blue), gpios);

static struct bt_conn *current_conn;
static atomic_t secured;
static atomic_t notify_enabled;
static atomic_t erasing;
/* Nach dem Einstecken ist das Kopplungsfenster offen */
static int64_t pairing_until = PAIRING_WINDOW_MS;

struct status {
	uint8_t flags;
	uint16_t pending;
	uint16_t free;
	uint8_t delay;
	uint8_t version;
} __packed;

static struct status last_status;

/* --- Kopplung -------------------------------------------------------- */

static void count_bond(const struct bt_bond_info *info, void *user_data)
{
	(*(int *)user_data)++;
}

static int bond_count(void)
{
	int n = 0;

	bt_foreach_bond(BT_ID_DEFAULT, count_bond, &n);
	return n;
}

/* Koppeln ist nur ohne Kopplungen oder im Kopplungsfenster erlaubt */
static bool pairing_allowed(void)
{
	return bond_count() == 0 || k_uptime_get() < pairing_until;
}

static enum bt_security_err pairing_accept(struct bt_conn *conn,
					   const struct bt_conn_pairing_feat *const feat)
{
	return pairing_allowed() ? BT_SECURITY_ERR_SUCCESS : BT_SECURITY_ERR_PAIR_NOT_ALLOWED;
}

static void pairing_complete(struct bt_conn *conn, bool bonded)
{
	pairing_until = 0;
}

static struct bt_conn_auth_cb auth_cb = {
	.pairing_accept = pairing_accept,
};

static struct bt_conn_auth_info_cb auth_info_cb = {
	.pairing_complete = pairing_complete,
};

/* --- Status ---------------------------------------------------------- */

static struct status build_status(void)
{
	struct status s = {
		.flags = (typer_usb_ready() ? STATUS_USB_READY : 0) |
			 (typer_caps_lock() ? STATUS_CAPS_LOCK : 0) |
			 (typer_busy() ? STATUS_TYPING : 0) |
			 (pairing_allowed() ? STATUS_PAIRING : 0),
		.pending = sys_cpu_to_le16(MIN(typer_pending(), UINT16_MAX)),
		.free = sys_cpu_to_le16(MIN(typer_free(), UINT16_MAX)),
		.delay = typer_get_delay(),
		.version = FW_VERSION,
	};
	return s;
}

static ssize_t status_read(struct bt_conn *conn, const struct bt_gatt_attr *attr, void *buf,
			   uint16_t len, uint16_t offset)
{
	struct status s = build_status();

	return bt_gatt_attr_read(conn, attr, buf, len, offset, &s, sizeof(s));
}

static void status_ccc_changed(const struct bt_gatt_attr *attr, uint16_t value)
{
	atomic_set(&notify_enabled, value == BT_GATT_CCC_NOTIFY);
}

static ssize_t cmd_write(struct bt_conn *conn, const struct bt_gatt_attr *attr, const void *buf,
			 uint16_t len, uint16_t offset, uint8_t flags);
static struct k_work erase_bonds_work;

BT_GATT_SERVICE_DEFINE(ds_svc,
	BT_GATT_PRIMARY_SERVICE(&ds_svc_uuid),
	BT_GATT_CHARACTERISTIC(&ds_cmd_uuid.uuid,
			       BT_GATT_CHRC_WRITE | BT_GATT_CHRC_WRITE_WITHOUT_RESP,
			       BT_GATT_PERM_WRITE_ENCRYPT, NULL, cmd_write, NULL),
	BT_GATT_CHARACTERISTIC(&ds_status_uuid.uuid,
			       BT_GATT_CHRC_READ | BT_GATT_CHRC_NOTIFY,
			       BT_GATT_PERM_READ_ENCRYPT, status_read, NULL, NULL),
	BT_GATT_CCC(status_ccc_changed, BT_GATT_PERM_READ | BT_GATT_PERM_WRITE_ENCRYPT),
);

static ssize_t cmd_write(struct bt_conn *conn, const struct bt_gatt_attr *attr, const void *buf,
			 uint16_t len, uint16_t offset, uint8_t flags)
{
	const uint8_t *data = buf;

	if (offset != 0) {
		return BT_GATT_ERR(BT_ATT_ERR_INVALID_OFFSET);
	}
	if (len < 1) {
		return BT_GATT_ERR(BT_ATT_ERR_INVALID_ATTRIBUTE_LEN);
	}

	switch (data[0]) {
	case CMD_DATA:
		if (typer_put(data + 1, len - 1) != 0) {
			return BT_GATT_ERR(ERR_QUEUE_FULL);
		}
		break;
	case CMD_CANCEL:
		typer_cancel();
		break;
	case CMD_DELAY:
		if (len < 2) {
			return BT_GATT_ERR(BT_ATT_ERR_INVALID_ATTRIBUTE_LEN);
		}
		typer_set_delay(data[1]);
		break;
	case CMD_UNPAIR:
		atomic_set(&erasing, 1);
		k_work_submit(&erase_bonds_work);
		break;
	default:
		return BT_GATT_ERR(BT_ATT_ERR_NOT_SUPPORTED);
	}
	return len;
}

static void status_work_handler(struct k_work *work);
static K_WORK_DELAYABLE_DEFINE(status_work, status_work_handler);

static void status_work_handler(struct k_work *work)
{
	struct status s = build_status();

	if (current_conn && atomic_get(&notify_enabled) &&
	    memcmp(&s, &last_status, sizeof(s)) != 0) {
		if (bt_gatt_notify(current_conn, &ds_svc.attrs[3], &s, sizeof(s)) == 0) {
			last_status = s;
		}
	}
	if (current_conn) {
		k_work_schedule(&status_work, K_MSEC(STATUS_INTERVAL_MS));
	}
}

/* --- Verbindung & Advertising ---------------------------------------- */

static const struct bt_data ad[] = {
	BT_DATA_BYTES(BT_DATA_FLAGS, (BT_LE_AD_GENERAL | BT_LE_AD_NO_BREDR)),
	BT_DATA_BYTES(BT_DATA_UUID128_ALL, BT_UUID_DS_SVC_VAL),
};

static const struct bt_data sd[] = {
	BT_DATA(BT_DATA_NAME_COMPLETE, CONFIG_BT_DEVICE_NAME, sizeof(CONFIG_BT_DEVICE_NAME) - 1),
};

static void adv_work_handler(struct k_work *work)
{
	bt_le_adv_start(BT_LE_ADV_CONN, ad, ARRAY_SIZE(ad), sd, ARRAY_SIZE(sd));
}
static K_WORK_DEFINE(adv_work, adv_work_handler);

static void connected(struct bt_conn *conn, uint8_t err)
{
	if (err) {
		return;
	}
	current_conn = bt_conn_ref(conn);
	memset(&last_status, 0xFF, sizeof(last_status));
	k_work_schedule(&status_work, K_MSEC(STATUS_INTERVAL_MS));
}

static void disconnected(struct bt_conn *conn, uint8_t reason)
{
	if (current_conn) {
		bt_conn_unref(current_conn);
		current_conn = NULL;
	}
	atomic_set(&secured, 0);
	atomic_set(&notify_enabled, 0);
}

static void security_changed(struct bt_conn *conn, bt_security_t level, enum bt_security_err err)
{
	atomic_set(&secured, !err && level >= BT_SECURITY_L2);
}

static void recycled(void)
{
	k_work_submit(&adv_work);
}

BT_CONN_CB_DEFINE(conn_callbacks) = {
	.connected = connected,
	.disconnected = disconnected,
	.security_changed = security_changed,
	.recycled = recycled,
};

static void erase_bonds_work_handler(struct k_work *work)
{
	if (current_conn) {
		bt_conn_disconnect(current_conn, BT_HCI_ERR_REMOTE_USER_TERM_CONN);
	}
	bt_unpair(BT_ID_DEFAULT, NULL);
	atomic_set(&erasing, 0);
}
static K_WORK_DEFINE(erase_bonds_work, erase_bonds_work_handler);

/* --- Taste & LEDs ---------------------------------------------------- */

static void leds(bool r, bool g, bool b)
{
	gpio_pin_set_dt(&led_red, r);
	gpio_pin_set_dt(&led_green, g);
	gpio_pin_set_dt(&led_blue, b);
}

static void ui_loop(void)
{
	int64_t pressed_at = -1;
	uint32_t tick = 0;

	for (;;) {
		int64_t now = k_uptime_get();
		bool blink = (tick / 5) % 2; /* 500 ms Takt */
		bool fast = tick % 2;        /* 100 ms Takt */

#if HAS_BUTTON
		bool down = gpio_pin_get_dt(&btn) > 0;

		/* Taste auswerten */
		if (down && pressed_at < 0) {
			pressed_at = now;
		} else if (!down && pressed_at >= 0) {
			int64_t held = now - pressed_at;

			if (held >= ERASE_HOLD_MS) {
				atomic_set(&erasing, 1);
				k_work_submit(&erase_bonds_work);
			} else if (held >= 30) {
				pairing_until = now + PAIRING_WINDOW_MS;
			}
			pressed_at = -1;
		}
#endif

		/* LED-Anzeige */
		if (atomic_get(&erasing) || (pressed_at >= 0 && now - pressed_at >= ERASE_HOLD_MS)) {
			leds(true, false, false);         /* rot: Kopplungen loeschen */
		} else if (typer_busy() && !typer_usb_ready()) {
			leds(blink, false, false);        /* rot blinkend: kein USB */
		} else if (typer_busy()) {
			leds(false, fast, false);         /* gruen flackernd: tippt */
		} else if (pairing_allowed() && !atomic_get(&secured)) {
			leds(false, false, blink);        /* blau blinkend: koppelbereit */
		} else if (atomic_get(&secured)) {
			leds(false, true, false);         /* gruen: verbunden */
		} else {
			leds(false, false, false);
		}

		tick++;
		k_msleep(100);
	}
}

int main(void)
{
#if HAS_BUTTON
	gpio_pin_configure_dt(&btn, GPIO_INPUT);
#endif
	gpio_pin_configure_dt(&led_red, GPIO_OUTPUT_INACTIVE);
	gpio_pin_configure_dt(&led_green, GPIO_OUTPUT_INACTIVE);
	gpio_pin_configure_dt(&led_blue, GPIO_OUTPUT_INACTIVE);

	/* Lebenszeichen beim Start: rot, gruen, blau nacheinander */
	leds(true, false, false);
	k_msleep(250);
	leds(false, true, false);
	k_msleep(250);
	leds(false, false, true);
	k_msleep(250);
	leds(false, false, false);

	if (typer_init() != 0) {
		leds(true, false, false);
	}

	bt_conn_auth_cb_register(&auth_cb);
	bt_conn_auth_info_cb_register(&auth_info_cb);

	if (bt_enable(NULL) == 0) {
		settings_load();
		k_work_submit(&adv_work);
	} else {
		leds(true, false, false);
	}

	ui_loop();
	return 0;
}
```

## src/keymap_de.c
```c
#include "keymap_de.h"

#include <zephyr/usb/class/hid.h>

#define S HID_KBD_MODIFIER_LEFT_SHIFT
#define A HID_KBD_MODIFIER_RIGHT_ALT /* AltGr */

/* HID-Usage-IDs der Tasten (Position auf der Tastatur) */
#define K_SPACE   0x2C
#define K_ENTER   0x28
#define K_TAB     0x2B
#define K_1       0x1E
#define K_0       0x27
#define K_SZ      0x2D /* ß ? \ */
#define K_ACUTE   0x2E /* ´ ` (Tottaste) */
#define K_UE      0x2F
#define K_PLUS    0x30 /* + * ~ */
#define K_HASH    0x32 /* # ' */
#define K_OE      0x33
#define K_AE      0x34
#define K_CARET   0x35 /* ^ ° (Tottaste) */
#define K_COMMA   0x36
#define K_DOT     0x37
#define K_MINUS   0x38
#define K_LESS    0x64 /* < > | */

#define KEY(c) (0x04 + ((c) - 'a'))

/* Taste fuer einen Kleinbuchstaben; Y und Z sind bei QWERTZ vertauscht */
static uint8_t letter_key(char c)
{
	if (c == 'y') {
		return KEY('z');
	}
	if (c == 'z') {
		return KEY('y');
	}
	return KEY(c);
}

static int one(struct keystroke *out, uint8_t mod, uint8_t key)
{
	out[0] = (struct keystroke){ .mod = mod, .key = key };
	return 1;
}

/* Tottaste gefolgt von Leerzeichen ergibt das Zeichen selbst */
static int dead(struct keystroke *out, uint8_t mod, uint8_t key)
{
	out[0] = (struct keystroke){ .mod = mod, .key = key };
	out[1] = (struct keystroke){ .key = K_SPACE };
	return 2;
}

/* Tottaste gefolgt von einem Vokal, z.B. ´ + e = é */
static int accent(struct keystroke *out, uint8_t mod, uint8_t key, char base, bool upper)
{
	out[0] = (struct keystroke){ .mod = mod, .key = key };
	out[1] = (struct keystroke){ .mod = upper ? S : 0, .key = letter_key(base), .caps = true };
	return 2;
}

static int lookup_ascii(char c, struct keystroke *out)
{
	if (c >= 'a' && c <= 'z') {
		out[0] = (struct keystroke){ .key = letter_key(c), .caps = true };
		return 1;
	}
	if (c >= 'A' && c <= 'Z') {
		out[0] = (struct keystroke){ .mod = S, .key = letter_key(c - 'A' + 'a'), .caps = true };
		return 1;
	}
	if (c >= '1' && c <= '9') {
		return one(out, 0, K_1 + (c - '1'));
	}

	switch (c) {
	case '0': return one(out, 0, K_0);
	case ' ': return one(out, 0, K_SPACE);
	case '\n': return one(out, 0, K_ENTER);
	case '\t': return one(out, 0, K_TAB);
	case '!': return one(out, S, K_1);
	case '"': return one(out, S, K_1 + 1);
	case '$': return one(out, S, K_1 + 3);
	case '%': return one(out, S, K_1 + 4);
	case '&': return one(out, S, K_1 + 5);
	case '/': return one(out, S, K_1 + 6);
	case '(': return one(out, S, K_1 + 7);
	case ')': return one(out, S, K_1 + 8);
	case '=': return one(out, S, K_0);
	case '{': return one(out, A, K_1 + 6);
	case '[': return one(out, A, K_1 + 7);
	case ']': return one(out, A, K_1 + 8);
	case '}': return one(out, A, K_0);
	case '?': return one(out, S, K_SZ);
	case '\\': return one(out, A, K_SZ);
	case '+': return one(out, 0, K_PLUS);
	case '*': return one(out, S, K_PLUS);
	case '~': return one(out, A, K_PLUS);
	case '#': return one(out, 0, K_HASH);
	case '\'': return one(out, S, K_HASH);
	case ',': return one(out, 0, K_COMMA);
	case ';': return one(out, S, K_COMMA);
	case '.': return one(out, 0, K_DOT);
	case ':': return one(out, S, K_DOT);
	case '-': return one(out, 0, K_MINUS);
	case '_': return one(out, S, K_MINUS);
	case '<': return one(out, 0, K_LESS);
	case '>': return one(out, S, K_LESS);
	case '|': return one(out, A, K_LESS);
	case '@': return one(out, A, KEY('q'));
	case '^': return dead(out, 0, K_CARET);
	case '`': return dead(out, S, K_ACUTE);
	default: return 0;
	}
}

int keymap_de_lookup(uint32_t cp, struct keystroke out[KEYMAP_MAX_STROKES])
{
	for (int i = 0; i < KEYMAP_MAX_STROKES; i++) {
		out[i] = (struct keystroke){ 0 };
	}

	if (cp < 0x80) {
		return lookup_ascii((char)cp, out);
	}

	switch (cp) {
	case 0x00E4: out[0] = (struct keystroke){ 0, K_AE, true }; return 1;  /* ä */
	case 0x00C4: out[0] = (struct keystroke){ S, K_AE, true }; return 1;  /* Ä */
	case 0x00F6: out[0] = (struct keystroke){ 0, K_OE, true }; return 1;  /* ö */
	case 0x00D6: out[0] = (struct keystroke){ S, K_OE, true }; return 1;  /* Ö */
	case 0x00FC: out[0] = (struct keystroke){ 0, K_UE, true }; return 1;  /* ü */
	case 0x00DC: out[0] = (struct keystroke){ S, K_UE, true }; return 1;  /* Ü */
	case 0x00DF: return one(out, 0, K_SZ);         /* ß */
	case 0x00A7: return one(out, S, K_1 + 2);      /* § */
	case 0x00B0: return one(out, S, K_CARET);      /* ° */
	case 0x00B2: return one(out, A, K_1 + 1);      /* ² */
	case 0x00B3: return one(out, A, K_1 + 2);      /* ³ */
	case 0x20AC: return one(out, A, KEY('e'));     /* € */
	case 0x00B5: return one(out, A, KEY('m'));     /* µ */
	case 0x03BC: return one(out, A, KEY('m'));     /* μ (griech. my) */
	case 0x00B4: return dead(out, 0, K_ACUTE);     /* ´ */

	case 0x00E1: return accent(out, 0, K_ACUTE, 'a', false); /* á */
	case 0x00E9: return accent(out, 0, K_ACUTE, 'e', false); /* é */
	case 0x00ED: return accent(out, 0, K_ACUTE, 'i', false); /* í */
	case 0x00F3: return accent(out, 0, K_ACUTE, 'o', false); /* ó */
	case 0x00FA: return accent(out, 0, K_ACUTE, 'u', false); /* ú */
	case 0x00C1: return accent(out, 0, K_ACUTE, 'a', true);  /* Á */
	case 0x00C9: return accent(out, 0, K_ACUTE, 'e', true);  /* É */
	case 0x00CD: return accent(out, 0, K_ACUTE, 'i', true);  /* Í */
	case 0x00D3: return accent(out, 0, K_ACUTE, 'o', true);  /* Ó */
	case 0x00DA: return accent(out, 0, K_ACUTE, 'u', true);  /* Ú */
	case 0x00E0: return accent(out, S, K_ACUTE, 'a', false); /* à */
	case 0x00E8: return accent(out, S, K_ACUTE, 'e', false); /* è */
	case 0x00EC: return accent(out, S, K_ACUTE, 'i', false); /* ì */
	case 0x00F2: return accent(out, S, K_ACUTE, 'o', false); /* ò */
	case 0x00F9: return accent(out, S, K_ACUTE, 'u', false); /* ù */
	case 0x00E2: return accent(out, 0, K_CARET, 'a', false); /* â */
	case 0x00EA: return accent(out, 0, K_CARET, 'e', false); /* ê */
	case 0x00EE: return accent(out, 0, K_CARET, 'i', false); /* î */
	case 0x00F4: return accent(out, 0, K_CARET, 'o', false); /* ô */
	case 0x00FB: return accent(out, 0, K_CARET, 'u', false); /* û */

	/* Typografische Zeichen auf tippbare Entsprechungen abbilden */
	case 0x00A0: /* geschuetztes Leerzeichen */
	case 0x202F:
	case 0x2009:
		return one(out, 0, K_SPACE);
	case 0x201C: case 0x201D: case 0x201E: /* “ ” „ */
		return one(out, S, K_1 + 1);
	case 0x2018: case 0x2019: case 0x201A: /* ‘ ’ ‚ */
		return one(out, S, K_HASH);
	case 0x2013: case 0x2014: case 0x2212: /* – — − */
		return one(out, 0, K_MINUS);
	case 0x2026: /* … */
		for (int i = 0; i < 3; i++) {
			out[i] = (struct keystroke){ .key = K_DOT };
		}
		return 3;
	default:
		return 0;
	}
}
```

## src/keymap_de.h
```c
/*
 * Deutsche Tastaturbelegung (QWERTZ, Windows/Linux) fuer USB-HID.
 */
#ifndef KEYMAP_DE_H_
#define KEYMAP_DE_H_

#include <stdbool.h>
#include <stdint.h>

#define KEYMAP_MAX_STROKES 3

struct keystroke {
	uint8_t mod;
	uint8_t key;
	/* Buchstabe, der von der Feststelltaste (Caps Lock) beeinflusst wird */
	bool caps;
};

/*
 * Liefert die Tastenanschlaege fuer ein Unicode-Zeichen.
 * Rueckgabe: Anzahl der Anschlaege (0 = Zeichen nicht tippbar).
 */
int keymap_de_lookup(uint32_t cp, struct keystroke out[KEYMAP_MAX_STROKES]);

#endif
```

## src/regout.c
```c
/*
 * Beim Makerdiary-Dongle liegt die GPIO-Spannung bei USB-Versorgung
 * standardmaessig bei 1,8 V. Das reicht nicht fuer die gruene und blaue LED,
 * daher einmalig auf 3,3 V umstellen (wie board.c des Nordic-Dongles).
 */
#include <zephyr/init.h>
#include <hal/nrf_power.h>

static int regout_init(void)
{
	if (nrf_power_mainregstatus_get(NRF_POWER) == NRF_POWER_MAINREGSTATUS_HIGH &&
	    (NRF_UICR->REGOUT0 & UICR_REGOUT0_VOUT_Msk) ==
		    (UICR_REGOUT0_VOUT_DEFAULT << UICR_REGOUT0_VOUT_Pos)) {
		NRF_NVMC->CONFIG = NVMC_CONFIG_WEN_Wen << NVMC_CONFIG_WEN_Pos;
		while (NRF_NVMC->READY == NVMC_READY_READY_Busy) {
		}
		NRF_UICR->REGOUT0 = (NRF_UICR->REGOUT0 & ~((uint32_t)UICR_REGOUT0_VOUT_Msk)) |
				    (UICR_REGOUT0_VOUT_3V3 << UICR_REGOUT0_VOUT_Pos);
		NRF_NVMC->CONFIG = NVMC_CONFIG_WEN_Ren << NVMC_CONFIG_WEN_Pos;
		while (NRF_NVMC->READY == NVMC_READY_READY_Busy) {
		}
		/* Aenderung wird erst nach einem Neustart wirksam. Nur neu starten, wenn
		 * das Schreiben geklappt hat, sonst liefe der Dongle in einer Neustart-Schleife. */
		if ((NRF_UICR->REGOUT0 & UICR_REGOUT0_VOUT_Msk) ==
		    (UICR_REGOUT0_VOUT_3V3 << UICR_REGOUT0_VOUT_Pos)) {
			NVIC_SystemReset();
		}
	}
	return 0;
}

SYS_INIT(regout_init, PRE_KERNEL_1, CONFIG_KERNEL_INIT_PRIORITY_DEFAULT);
```

## src/typer.c
```c
#include "typer.h"
#include "keymap_de.h"

#include <errno.h>
#include <zephyr/device.h>
#include <zephyr/kernel.h>
#include <zephyr/sys/atomic.h>
#include <zephyr/sys/ring_buffer.h>
#include <zephyr/usb/class/usb_hid.h>
#include <zephyr/usb/usb_device.h>

#define DEFAULT_DELAY_MS 5
#define MAX_DELAY_MS     100
#define ESCAPE           0x00
#define ESCAPE_PAUSE     0xFF

static const uint8_t hid_report_desc[] = HID_KEYBOARD_REPORT_DESC();

static const struct device *hid_dev;
static K_SEM_DEFINE(ep_sem, 0, 1);
static K_SEM_DEFINE(data_sem, 0, 1);
static struct k_spinlock queue_lock;
RING_BUF_DECLARE(queue, TYPER_QUEUE_SIZE);

static atomic_t usb_ready;
static atomic_t caps_lock;
static atomic_t busy;
static atomic_t cancel_req;
static atomic_t delay_ms = ATOMIC_INIT(DEFAULT_DELAY_MS);

/* --- USB ------------------------------------------------------------- */

static void usb_status_cb(enum usb_dc_status_code status, const uint8_t *param)
{
	switch (status) {
	case USB_DC_CONFIGURED:
	case USB_DC_RESUME:
		atomic_set(&usb_ready, 1);
		break;
	case USB_DC_RESET:
	case USB_DC_DISCONNECTED:
	case USB_DC_SUSPEND:
		atomic_set(&usb_ready, 0);
		break;
	default:
		break;
	}
}

static void int_in_ready_cb(const struct device *dev)
{
	k_sem_give(&ep_sem);
}

/* Der Host meldet den Zustand der Tastatur-LEDs (Num/Caps/Scroll Lock) */
static int set_report_cb(const struct device *dev, struct usb_setup_packet *setup,
			 int32_t *len, uint8_t **data)
{
	if (*len >= 1) {
		atomic_set(&caps_lock, ((*data)[0] & HID_KBD_LED_CAPS_LOCK) != 0);
	}
	return 0;
}

static const struct hid_ops hid_ops = {
	.int_in_ready = int_in_ready_cb,
	.set_report = set_report_cb,
};

static int hid_send(uint8_t mod, uint8_t key)
{
	uint8_t report[8] = { mod, 0, key, 0, 0, 0, 0, 0 };
	int err;

	k_sem_reset(&ep_sem);
	err = hid_int_ep_write(hid_dev, report, sizeof(report), NULL);
	if (err) {
		return err;
	}
	return k_sem_take(&ep_sem, K_MSEC(100));
}

/* --- Tippen ---------------------------------------------------------- */

static bool cancelled(void)
{
	return atomic_get(&cancel_req) != 0;
}

/* Wartet, bis der Host die Tastatur eingebunden hat. */
static bool wait_usb(void)
{
	while (!atomic_get(&usb_ready)) {
		if (cancelled()) {
			return false;
		}
		k_msleep(50);
	}
	return true;
}

static void pause_ms(uint32_t ms)
{
	k_msleep(ms);
}

static void press(uint8_t mod, uint8_t key)
{
	uint32_t d = atomic_get(&delay_ms);

	if (!wait_usb()) {
		return;
	}

	/*
	 * Modifier zuerst allein senden: manche Programme (z.B. Remote-Desktop)
	 * verlieren sonst Shift/AltGr, wenn es im selben Report wie die Taste kommt.
	 */
	if (mod) {
		hid_send(mod, 0);
		pause_ms(d);
	}
	hid_send(mod, key);
	pause_ms(d);
	if (mod) {
		hid_send(mod, 0);
		pause_ms(d);
	}
	hid_send(0, 0);
	pause_ms(d);
}

static void type_codepoint(uint32_t cp)
{
	struct keystroke ks[KEYMAP_MAX_STROKES];
	int n = keymap_de_lookup(cp, ks);

	for (int i = 0; i < n && !cancelled(); i++) {
		uint8_t mod = ks[i].mod;

		/* Bei aktiver Feststelltaste Shift umkehren, damit Gross/Klein stimmt */
		if (ks[i].caps && atomic_get(&caps_lock)) {
			mod ^= HID_KBD_MODIFIER_LEFT_SHIFT;
		}
		press(mod, ks[i].key);
	}
}

static bool queue_get(uint8_t *b)
{
	k_spinlock_key_t key = k_spin_lock(&queue_lock);
	bool ok = ring_buf_get(&queue, b, 1) == 1;

	k_spin_unlock(&queue_lock, key);
	return ok;
}

static void typer_thread(void *p1, void *p2, void *p3)
{
	/* Zustand des Decoders */
	uint32_t cp = 0;
	int utf8_left = 0;
	int esc_state = 0;
	uint8_t esc_mod = 0;
	uint8_t b;

	for (;;) {
		if (atomic_cas(&cancel_req, 1, 0)) {
			utf8_left = 0;
			esc_state = 0;
			if (atomic_get(&usb_ready)) {
				hid_send(0, 0);
			}
		}

		if (!queue_get(&b)) {
			atomic_set(&busy, 0);
			k_sem_take(&data_sem, K_FOREVER);
			continue;
		}
		atomic_set(&busy, 1);

		if (esc_state == 1) {
			esc_mod = b;
			esc_state = 2;
			continue;
		}
		if (esc_state == 2) {
			esc_state = 0;
			if (esc_mod == ESCAPE_PAUSE) {
				pause_ms(b * 10U);
			} else {
				press(esc_mod, b);
			}
			continue;
		}
		if (b == ESCAPE) {
			esc_state = 1;
			utf8_left = 0;
			continue;
		}

		/* UTF-8 dekodieren */
		if (b < 0x80) {
			utf8_left = 0;
			type_codepoint(b);
		} else if ((b & 0xC0) == 0x80) {
			if (utf8_left > 0) {
				cp = (cp << 6) | (b & 0x3F);
				if (--utf8_left == 0) {
					type_codepoint(cp);
				}
			}
		} else if ((b & 0xE0) == 0xC0) {
			cp = b & 0x1F;
			utf8_left = 1;
		} else if ((b & 0xF0) == 0xE0) {
			cp = b & 0x0F;
			utf8_left = 2;
		} else if ((b & 0xF8) == 0xF0) {
			cp = b & 0x07;
			utf8_left = 3;
		} else {
			utf8_left = 0;
		}
	}
}

K_THREAD_DEFINE(typer_tid, 1536, typer_thread, NULL, NULL, NULL, 5, 0, 0);

/* --- Oeffentliche Schnittstelle --------------------------------------- */

int typer_init(void)
{
	hid_dev = device_get_binding("HID_0");
	if (hid_dev == NULL) {
		return -ENODEV;
	}

	usb_hid_register_device(hid_dev, hid_report_desc, sizeof(hid_report_desc), &hid_ops);
	usb_hid_init(hid_dev);
	return usb_enable(usb_status_cb);
}

int typer_put(const uint8_t *data, size_t len)
{
	k_spinlock_key_t key = k_spin_lock(&queue_lock);
	int ret = 0;

	if (ring_buf_space_get(&queue) < len) {
		ret = -ENOMEM;
	} else {
		ring_buf_put(&queue, data, len);
	}
	k_spin_unlock(&queue_lock, key);

	if (ret == 0 && len > 0) {
		atomic_set(&busy, 1);
		k_sem_give(&data_sem);
	}
	return ret;
}

void typer_cancel(void)
{
	k_spinlock_key_t key = k_spin_lock(&queue_lock);

	ring_buf_reset(&queue);
	k_spin_unlock(&queue_lock, key);
	atomic_set(&cancel_req, 1);
	k_sem_give(&data_sem);
}

void typer_set_delay(uint8_t ms)
{
	atomic_set(&delay_ms, CLAMP(ms, 1, MAX_DELAY_MS));
}

uint8_t typer_get_delay(void)
{
	return atomic_get(&delay_ms);
}

uint32_t typer_pending(void)
{
	k_spinlock_key_t key = k_spin_lock(&queue_lock);
	uint32_t n = ring_buf_size_get(&queue);

	k_spin_unlock(&queue_lock, key);
	return n;
}

uint32_t typer_free(void)
{
	return TYPER_QUEUE_SIZE - typer_pending();
}

bool typer_busy(void)
{
	return atomic_get(&busy) != 0;
}

bool typer_usb_ready(void)
{
	return atomic_get(&usb_ready) != 0;
}

bool typer_caps_lock(void)
{
	return atomic_get(&caps_lock) != 0;
}
```

## src/typer.h
```c
/*
 * Tipp-Engine: nimmt Text (UTF-8) entgegen und tippt ihn ueber USB-HID ein.
 *
 * Datenstrom-Format:
 *   UTF-8-Text                  wird als Text getippt ('\n' = Enter, '\t' = Tab)
 *   0x00 <mod> <key>            einzelner Tastenanschlag (HID-Modifier + Usage-ID)
 *   0x00 0xFF <n>               Pause von n * 10 ms
 */
#ifndef TYPER_H_
#define TYPER_H_

#include <stdbool.h>
#include <stddef.h>
#include <stdint.h>

#define TYPER_QUEUE_SIZE 4096

int typer_init(void);

/* Haengt Daten an die Warteschlange an. -ENOMEM, wenn nicht genug Platz ist. */
int typer_put(const uint8_t *data, size_t len);

/* Bricht das Tippen ab und leert die Warteschlange. */
void typer_cancel(void);

void typer_set_delay(uint8_t ms);
uint8_t typer_get_delay(void);

uint32_t typer_pending(void);
uint32_t typer_free(void);
bool typer_busy(void);
bool typer_usb_ready(void);
bool typer_caps_lock(void);

#endif
```
